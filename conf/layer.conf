## conf/layer.conf
```bitbake
# We have a conf and classes directory, add to BBPATH
BBPATH .= ":${LAYERDIR}"

# We have recipes-* directories, add to BBFILES
BBFILES += "\
    ${LAYERDIR}/recipes*/*/*.bb \
    ${LAYERDIR}/recipes*/*/*.bbappend \
    ${LAYERDIR}/images/*.bb \
    "

BBFILE_COLLECTIONS += "meta-flutter-vm"
BBFILE_PATTERN_meta-flutter-vm = "^${LAYERDIR}/"
BBFILE_PRIORITY_meta-flutter-vm = "5"

LAYERVERSION_meta-flutter-vm = "4"
LAYERSERIES_COMPAT_meta-flutter-vm = "kirkstone"

LAYERDEPENDS_meta-flutter-vm = "virtualization-layer"
```
